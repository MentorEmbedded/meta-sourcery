## conf/distro/include/csl-versions.inc
```bitbake
def csl_run(d, cmd, *args):
	import bb.process
	import subprocess

	topdir = d.getVar('TOPDIR', True)
	toolchain_path = d.getVar('EXTERNAL_TOOLCHAIN', True)
	if not toolchain_path:
		return 'UNKNOWN', 'UNKNOWN'

	target_prefix = d.getVar('TOOLCHAIN_BINARY_PREFIX', True)
	path = os.path.join(toolchain_path, 'bin', target_prefix + cmd)
	args = [path] + list(args)

	return bb.process.run(args, cwd=topdir, stderr=subprocess.PIPE)

def csl_get_version(d):
        try:
		stdout, stderr = csl_run(d, 'gcc', '-v')
	except bb.process.CmdError as exc:
		bb.error('Failed to obtain CodeSourcery toolchain version: %s' % exc)
		return 'UNKNOWN'
	else:
		last_line = stderr.splitlines()[-1]
		return last_line

def csl_get_main_version(d):
	version = csl_get_version(d)
	if version != 'UNKNOWN':
		return version.split()[-1].rstrip(')')
	else:
		return version

def csl_get_gcc_version(d):
	version = csl_get_version(d)
	if version != 'UNKNOWN':
		return version.split()[2]
	else:
		return version

def csl_get_libc_version(d):
	import os,bb
	syspath = d.expand('${EXTERNAL_TOOLCHAIN}/${CSL_TARGET_SYS}')
        # We like to archive the libc directory, so looking at the name
	# of libc-VERSION.so doesn't always work. One option is to just
	# have a file that exists only to communicate this.
	if syspath and os.path.exists(syspath):
		for file in os.listdir(syspath):
			if file.find('libc-version-') == 0:
				return file[13:]

	# Okay, how about we try searching for a libc-VERSION.so then?
	sysroot = d.getVar('EXTERNAL_TOOLCHAIN_SYSROOT', True)
	if not sysroot:
	        return 'UNKNOWN'

	libpath = os.path.join(sysroot, 'lib')
	if os.path.exists(libpath):
		for file in os.listdir(libpath):
			if file.find('libc-') == 0:
				return file[5:-3]
	return 'UNKNOWN'

def csl_get_kernel_version(d):
	sysroot = d.getVar('EXTERNAL_TOOLCHAIN_SYSROOT', True)
	if not sysroot:
	        return 'UNKNOWN'

	vf = os.path.join(sysroot, 'usr/include/linux/version.h')

	try:
		f = open(vf, 'r')
	except (OSError, IOError):
		return 'UNKNOWN'

        with f:
	    for line in f.readlines():
		if 'LINUX_VERSION_CODE' in line:
			ver = int(line.split()[2])
			maj = ver / 65536
			ver = ver % 65536
			min = ver / 256
			ver = ver % 256
			return '%s.%s.%s' % (maj, min, ver)
	return 'UNKNOWN'

def csl_get_gdb_version(d):
	try:
		stdout, stderr = csl_run(d, 'gdb', '-v')
	except bb.process.CmdError as c:
		return 'UNKNOWN(%s)' % c
	else:
		first_line = stdout.splitlines()[0]
		return first_line.split()[-1]

python csl_version_handler () {
    if not isinstance(e, bb.event.ConfigParsed):
        return
    d = e.data
    ld = d.createCopy()
    ld.finalize()

    d.setVar('CSL_VER_MAIN', csl_get_main_version(ld))
    d.setVar('CSL_VER_GCC', csl_get_gcc_version(ld))
    # Allow manual specification of libc/kernel versions.
    if not d.getVar('CSL_VER_LIBC'):
        d.setVar('CSL_VER_LIBC', csl_get_libc_version(ld))
    if not d.getVar('CSL_VER_KERNEL'):
        d.setVar('CSL_VER_KERNEL', csl_get_kernel_version(ld))
    d.setVar('CSL_VER_GDB', csl_get_gdb_version(ld))
}
addhandler csl_version_handler

# Ensure that any variable which includes the --sysroot (CC, CXX, etc) also
# depends on the toolchain version
TOOLCHAIN_OPTIONS[vardeps] += "CSL_VER_MAIN CSL_VER_GCC"
```

## conf/distro/include/external-sourcery-blacklist.inc
```bitbake
# When the meta-sourcery layer is included, only the binary toolchain is
# supported.  Blacklist the standard toolchain components to avoid problems.
META_SOURCERY_BLACKLIST_MESSAGE = "The prebuilt toolchain precludes building certain toolchain packages."

# binutils needs to be allowed for oprofile
# PNBLACKLIST[binutils] = "${META_SOURCERY_BLACKLIST_MESSAGE}"
PNBLACKLIST[linux-libc-headers] = "${META_SOURCERY_BLACKLIST_MESSAGE}"
PNBLACKLIST[eglibc] = "${META_SOURCERY_BLACKLIST_MESSAGE}"
PNBLACKLIST[eglibc-initial] = "${META_SOURCERY_BLACKLIST_MESSAGE}"
# PNBLACKLIST[libiconv] = "${META_SOURCERY_BLACKLIST_MESSAGE}"
PNBLACKLIST[gdb] = "${META_SOURCERY_BLACKLIST_MESSAGE}"
PNBLACKLIST[gcc] = "${META_SOURCERY_BLACKLIST_MESSAGE}"
PNBLACKLIST[libgcc] = "${META_SOURCERY_BLACKLIST_MESSAGE}"
PNBLACKLIST[gcc-cross-initial] = "${META_SOURCERY_BLACKLIST_MESSAGE}"
PNBLACKLIST[external-csl-toolchain] = "${META_SOURCERY_BLACKLIST_MESSAGE}"
PNBLACKLIST[prelink] = "${META_SOURCERY_BLACKLIST_MESSAGE}"

PNBLACKLIST[binutils-cross] = "${META_SOURCERY_BLACKLIST_MESSAGE}"
PNBLACKLIST[gcc-cross] = "${META_SOURCERY_BLACKLIST_MESSAGE}"
PNBLACKLIST[gcc-runtime] = "${META_SOURCERY_BLACKLIST_MESSAGE}"
PNBLACKLIST[gdb-cross] = "${META_SOURCERY_BLACKLIST_MESSAGE}"
PNBLACKLIST[mklibs-native] = "${META_SOURCERY_BLACKLIST_MESSAGE}"
PNBLACKLIST[prelink-native] = "${META_SOURCERY_BLACKLIST_MESSAGE}"

# Requires gcc...
GCCMAKEDEPBLMSG = "Using the prebuilt toolchain precludes building gcc which is required by this package."
GCCMAKEDEPBLMSG_i686 = ""
GCCMAKEDEPBLMSG_i586 = ""
PNBLACKLIST[gccmakedep] = "${GCCMAKEDEPBLMSG}"

PGTCDEPBLMSG = "Using the prebuilt toolchain precludes building this packagegroup."
PGTCDEPBLMSG_x86-64 = ""
PGTCDEPBLMSG_i686 = ""
PGTCDEPBLMSG_i586 = ""
PNBLACKLIST[packagegroup-core-buildessential] = "${PGTCDEPBLMSG}"
PNBLACKLIST[packagegroup-core-sdk] = "${PGTCDEPBLMSG}"
PNBLACKLIST[packagegroup-self-hosted] = "${PGTCDEPBLMSG}"
PNBLACKLIST[packagegroup-core-sdk-gmae] = "${PGTCDEPBLMSG}"
```

## conf/distro/include/sourcery-tuning.inc
```bitbake
# Sourcery G++'s binutils isn't patched with armv5e support
ARMPKGSFX_THUMB_armv5 = "${@bb.utils.contains("TUNE_FEATURES", "thumb", "${ARM_THUMB_SUFFIX}", "", d)}"

# Use the additional tuning flags which Sourcery G++ provides in certain
# cases, to ensure that the correct multilibs are used. E.g. '-te500v2'.
SOURCERY_GXX_IS_PRO = "${@'1' if os.path.exists('${EXTERNAL_TOOLCHAIN}/license') else '0'}"

# Workaround for ICE of gcc-4.8.x when passing -mfloat-gprs=double
# Bug: http://gcc.gnu.org/bugzilla/show_bug.cgi?id=57717#c1
# Replace double-float with single-float, revert this when above bug is fixed
PPCE500V2_CCARG = "${@'-te500v2' if d.getVar('SOURCERY_GXX_IS_PRO', True) == '1' else '-mcpu=8548 -mabi=spe -mspe -mfloat-gprs=single'}"
TUNE_CCARGS_append = "${@bb.utils.contains('TUNE_FEATURES', 'ppce500v2', ' ' + d.getVar('PPCE500V2_CCARG', True), '', d)}"

PPCE500MC_CCARG = "${@'-te500mc' if d.getVar('SOURCERY_GXX_IS_PRO', True) == '1' else '-mcpu=e500mc'}"
TUNE_CCARGS_append = "${@bb.utils.contains('TUNE_FEATURES', 'ppce500mc', ' ' + d.getVar('PPCE500MC_CCARG', True), '', d)}"

PPCE6500_CCARG = "${@'-te6500' if d.getVar('SOURCERY_GXX_IS_PRO', True) == '1' else '-mcpu=e6500'}"
TUNE_CCARGS_append = " ${@bb.utils.contains("TUNE_FEATURES", "e6500", ' ' + d.getVar('PPCE6500_CCARG', True), '', d)}"
TUNE_ASARGS += "${@bb.utils.contains("TUNE_FEATURES", "m64", "-a64 -me6500", "", d)}"

TUNE_CCARGS_remove_t4240rdb-64b = "-mcpu=e6500"
```

## conf/distro/include/tcmode-external-sourcery-baremetal.inc
```bitbake
PREFERRED_PROVIDER_linux-libc-headers = ""
PREFERRED_PROVIDER_virtual/libc ?= "newlib-external"
PREFERRED_PROVIDER_virtual/libintl ?= ""
PREFERRED_PROVIDER_virtual/libiconv ?= ""
PREFERRED_PROVIDER_virtual/${TARGET_PREFIX}libc-for-gcc ?= ""
PREFERRED_PROVIDER_virtual/${TARGET_PREFIX}libc-initial ?= ""
USE_NLS ?= "no"
IMAGE_LINGUAS = ""
LIBC_DEPENDENCIES = ""
EXTERNAL_TARGET_SYSTEMS[arm] ?= "arm-none-eabi"
EXTERNAL_TARGET_SYSTEMS[aarch64] ?= "aarch64-none-elf"
require conf/distro/include/tcmode-external-sourcery.inc
PREFERRED_PROVIDER_newlib = "newlib-external"
TCLIBC = "baremetal"
BASELIB_aarch64 = "lib"
```

## conf/distro/include/tcmode-external-sourcery-rebuild-libc.inc
```bitbake
require conf/distro/include/tcmode-external-sourcery.inc

TCMODEOVERRIDES .= ":tcmode-external-sourcery-rebuild-libc"

SKIP_RECIPE[glibc] = ""
PREFERRED_PROVIDER_glibc = "glibc"
PREFERRED_PROVIDER_virtual/libc = "glibc"
PREFERRED_PROVIDER_virtual/libintl = "glibc"
PREFERRED_PROVIDER_virtual/libiconv = "glibc"
```

## conf/distro/include/tcmode-external-sourcery.inc
```bitbake
require conf/distro/include/tcmode-external-oe-sdk.inc

# Also relocate the included external toolchain
SDK_CLASSES ??= ""
SDK_CLASSES:append = " sdk-relocate-toolchain"
IMAGE_CLASSES:append = " ${SDK_CLASSES}"

def codebench_toolchain_dirname(d):
    external, toolchains = d.getVar('EXTERNAL_TOOLCHAIN'), d.getVar('TOOLCHAINS_PATH')
    if external and toolchains and oe.path.is_path_parent(toolchains, external):
        return os.path.relpath(external, toolchains)

EXTERNAL_TOOLCHAINS_DIR = "${@codebench_toolchain_dirname(d) or d.getVar('EXTERNAL_TARGET_SYS')}"
EXTERNAL_TOOLCHAINS_DIR[vardepvalue] = "${EXTERNAL_TOOLCHAINS_DIR}"

SDKPATHTOOLCHAIN ?= "${SDKPATH}/toolchains/${EXTERNAL_TOOLCHAINS_DIR}"

TCMODEOVERRIDES .= ":tcmode-external-sourcery"

# Disable pseudo for these cross binaries
EXTERNAL_CROSS_NOPSEUDO = "gcc g++ cpp"

# Use tuning-defined baselib to align with multilib and external toolchain
baselib = "${@d.getVar('BASE_LIB:tune-' + (d.getVar('DEFAULTTUNE') or 'INVALID')) or d.getVar('BASELIB')}"

# Ensure that the licensing variables are available to the toolchain.
export SALT_EXCLUDE_LICENSES
export SALT_INCLUDE_LICENSES
export SALT_LICENSE_SERVER
export SALT_LICENSE_SOURCE 
export SALT_LOGGING_DIR
export SALT_PKGINFO_FILE

def sourcery_version(d):
    version_output = external_run(d, d.getVar('EXTERNAL_CC') or 'gcc', '-v')

    try:
        version = version_output.splitlines()[-1]
    except IndexError:
        bb.error('Unexpected output for {}: {}'.format(d.getVar('EXTERNAL_TOOLCHAIN_BIN') + '/' + (d.getVar('EXTERNAL_CC') or 'gcc') + ' -v', version_output))
        version = 'UNKNOWN'

    if version != 'UNKNOWN':
        main_version = version.split()[-1].rstrip(')')
        if main_version == 'Preview':
            main_version = version.split()[-3]
        elif main_version != '(GCC':
            return main_version
    return 'UNKNOWN'

SOURCERY_VERSION = "${@sourcery_version(d)}"
SOURCERY_VERSION_allarch = ""
SOURCERY_VERSION[vardepvalue] = "${SOURCERY_VERSION}"

# Add sourcery toolchain version to external recipe versions
EXTERNAL_PV_SUFFIX ?= "${@'-${SOURCERY_VERSION}' if d.getVar('SOURCERY_VERSION') != 'UNKNOWN' else ''}"
EXTERNAL_PV_SUFFIX[vardepvalue] = "${EXTERNAL_PV_SUFFIX}"
EXTERNAL_PV_SUFFIX_allarch = ""

# Make it clear that this version is the toolchain, not the CodeBench IDE
SOURCERY_TOOLCHAIN_VERSION = "${SOURCERY_VERSION}"

BUILDCFG_VARS += "${@'SOURCERY_TOOLCHAIN_VERSION' if d.getVar('SOURCERY_VERSION') != 'UNKNOWN' else ''}"

SOURCERY_LICENSE_NETWORK_TASKS = "\
    do_configure \
    do_compile \
    do_compile_kernelmodules \
    do_install \
    do_bundle_initramfs \
    do_configure_ptest \
    do_compile_ptest \
    do_install_ptest \
"

python sourcery_metadata_setup () {
    # Ensure that changes to toolchain licensing don't affect checksums
    d.appendVar('BB_BASEHASH_IGNORE_VARS', ' SALT_LICENSE_SERVER SALT_EXCLUDE_LICENSES SALT_INCLUDE_LICENSES SALT_LOGGING_DIR SALT_PKGINFO_FILE SALT_LICENSE_SOURCE ')

    # Let the toolchain contact the license server by enabling networking in compile tasks
    if d.getVar('SALT_LICENSE_SERVER'):
        for task in d.getVar('SOURCERY_LICENSE_NETWORK_TASKS').split():
            d.setVarFlag(task, 'network', '1')
}
sourcery_metadata_setup[eventmask] = "bb.event.ConfigParsed"
addhandler sourcery_metadata_setup

python extract_env_setup_metadata:prepend() {
    from pathlib import Path
    external_toolchain = d.getVar('EXTERNAL_TOOLCHAIN')
    if not external_toolchain or external_toolchain == 'UNKNOWN':
        external_toolchains = d.getVar('EXTERNAL_TOOLCHAINS')
        if not external_toolchains or external_toolchains == 'UNKNOWN':
            toolchains_path = d.getVar('TOOLCHAINS_PATH')
            if not toolchains_path:
                codebench_path = d.getVar('CODEBENCH_PATH')
                if codebench_path:
                    bb.warn('CODEBENCH_PATH is deprecated, please define TOOLCHAINS_PATH')
                    toolchains_path = Path(codebench_path).resolve().parent / 'toolchains'
                else:
                    bb.fatal('EXTERNAL_TOOLCHAIN, EXTERNAL_TOOLCHAINS, or TOOLCHAINS_PATH must be set')
            external_toolchains = ' '.join(str(p) for p in Path(toolchains_path).glob('*/'))
            if not external_toolchains:
                bb.fatal('{}/../toolchains does not exist or is empty'.format(toolchains_path))
            d.setVar('EXTERNAL_TOOLCHAINS', external_toolchains)
}
```

## conf/distro/include/tcmode-extra-build-libc.inc
```bitbake
# Disable the prebuilt package.
PNBLACKLIST[eglibc-sourcery-compile] = ""
PNBLACKLIST[eglibc-sourcery-binary] = "You are building libc from source, and cannot use the prebuilt. Check TCMODE_EXTRA."

PREFERRED_PROVIDER_virtual/libc = "eglibc-sourcery-compile"
PREFERRED_PROVIDER_virtual/libiconv = "eglibc-sourcery-compile"
PREFERRED_PROVIDER_virtual/libintl = "eglibc-sourcery-compile"
PREFERRED_PROVIDER_virtual/${TARGET_PREFIX}libc-for-gcc = "eglibc-sourcery-compile"
PREFERRED_PROVIDER_eglibc = "eglibc-sourcery-compile"
CSL_SRC_URI ?= "file://${CSL_SRC_FILE}"
CSL_SRC_FILE ?= "${@bb.fatal('Please set CSL_SRC_FILE to the path to your sourcery src tarball')}"
```

## conf/distro/include/tcmode-extra-build-target-toolchain.inc
```bitbake
# Disable the prebuilt package.
PNBLACKLIST[binutils] = ""
PNBLACKLIST[gcc] = ""
PNBLACKLIST[prelink] = ""
PNBLACKLIST[gccmakedep] = ""
PNBLACKLIST[packagegroup-core-buildessential] = ""
PNBLACKLIST[packagegroup-core-sdk] = ""
PNBLACKLIST[packagegroup-self-hosted] = ""
PNBLACKLIST[packagegroup-core-sdk-gmae] = ""
PNBLACKLIST[sourcery-tc] = "You are building the toolchain from source, and cannot use the prebuilt. Check TCMODE_EXTRA."

# Restore the preferred provider
PREFERRED_PROVIDER_binutils = "binutils"
PREFERRED_PROVIDER_gcc      = "gcc"
PREFERRED_PROVIDER_prelink  = "prelink"

VIRTUAL-RUNTIME_toolchain        = "binutils cpp gcc g++"
VIRTUAL-RUNTIME_toolchain_x86-64 = "binutils cpp gcc g++"
```

## conf/layer.conf
```bitbake
BBPATH .= ":${LAYERDIR}"
BBFILES += "${LAYERDIR}/recipes-*/*/*.bb \
            ${LAYERDIR}/recipes-*/*/*.bbappend"
BBFILE_COLLECTIONS += "sourcery"
BBFILE_PRIORITY_sourcery = "2"
BBFILE_PATTERN_sourcery = "^${LAYERDIR}/"

LAYERDEPENDS_sourcery = "core external-toolchain"
LAYERSERIES_COMPAT_sourcery = "warrior zeus dunfell gatesgarth"

BBFILES += "${@' '.join('${LAYERDIR}/%s/recipes*/*/*.%s' % (layer, ext) \
               for layer in '${BBFILE_COLLECTIONS}'.split() for ext in ['bb', 'bbappend'])}"
```

## conf/machine/include/tune-ppce500.inc
```bitbake
DEFAULTTUNE ?= "ppce500"

require conf/machine/include/powerpc/arch-powerpc.inc

TUNE_PKGARCH = "${TUNE_PKGARCH_tune-${DEFAULTTUNE}}"
TUNE_PKGARCH_tune-powerpc = "powerpc"
TUNE_PKGARCH_tune-powerpc-nf = "powerpc-nf"

TUNEVALID[ppce500] = "Enable ppce500 specific processor optimizations"
TUNE_CCARGS += "${@bb.utils.contains("TUNE_FEATURES", "ppce500", "-te500", "", d)}"

# Note that SPE is implied by the ppce500 feature
TARGET_FPU .= "${@bb.utils.contains("TUNE_FEATURES", "ppce500", "ppc-efs", "", d)}"

AVAILTUNES += "ppce500"
TUNE_FEATURES_tune-ppce500 = "m32 ppce500"
TUNE_PKGARCH_tune-ppce500 = "ppce500"
PACKAGE_EXTRA_ARCHS_tune-ppce500 = "ppce500"
```
